## Documentation/devicetree/bindings/net/dsa/mvmdio.txt
```
Marvell SOHU Switch sysfs Device Tree Bindings
----------------------------------------------

The Sysfs driver (also referred to as the dsa_mvmdio driver) is designed to provide access to the SMI/XSMI bus from the user space. This driver is available from the LSP 17.08 release onwards.

Sysfs Interface
Sysfs is available for accessing SOHO switch registers from the user space. The following are Sysfs paths:
Read register - /sys/devices/platform/dsa_mvmdio/read
Write register - /sys/devices/platform/dsa_mvmdio/write
Dump registers - /sys/devices/platform/dsa_mvmdio/dump
Print help - /sys/devices/platform/dsa_mvmdio/help
Updating values in these files from the user space reads or modifies the switch internal register values. The purpose of this is to debug switch functionality by reading/writing of registers.

Compilation
To enable this driver, set the compilation flag CONFIG_MV_DSA_MVMVDIO

DTS Configuration Example
This is an example configuration for a Marvell board.
The customer should remove one the "mii-bus" or "xmii-bus" parameters as needed.
{
	cpn-110-master {
		config-space {
			mdio: mdio@12a200 {
				#address-cells = <1>;
				#size-cells = <0>;
			};
			xmdio: mdio@15b000 {
				#address-cells = <1>;
				#size-cells = <0>;
			};
			dsa_mvmdio {
				compatible = "marvell,dsa-mvmdio";
				status = "okay";
				mii-bus = <&mdio>; /* remove if using only xmii */
				xmii-bus = <&xmdio>; /* remove if using only mii */
				sw-smi-addr = <3>;
			};
		};
	};
}

Usage
help Displays all available switch commands and their syntax. # cd /sys/devices/platform/dsa_mvmdio
   cat help
read - Reads a register
   echo [type] [port] [xdev] [reg] > read
write - Writes to a register
   echo [type] [port] [xdev] [reg] [val] > write
dump - Dumps 0 to 32 registers
   echo [type] [port] [xdev] > dump

The following parameters are in hexadecimal:
type
   0 - Switch registers
   1 - Switch internal PHY registers
   2 - Switch external PHY registers
   3 - Regular Gigabit PHY
   4 - Extended PHY i.e. 100G phy
port
   PHY ID for PHYs.
   Port address for switches. The port address equals the port number for the Peridot family; otherwise the port address is 0x10 + port number.
   For global 1 and global 2 registers of the switch, this parameter is the device address, ie. 0X1b and 0x1c respectively.
xdev
   Device address for extended PHY, i.e. type = 4.
   0 otherwise.
reg - Register address
val - Value
```

## Documentation/devicetree/bindings/sound/xlnx,spdif.txt
```
Device-Tree bindings for Xilinx SPDIF IP

The IP supports playback and capture of SPDIF audio

Required properties:
 - compatible: "xlnx,spdif-2.0"
 - clock-names: List of input clocks.
   Required elements for SPDIF Tx: "aud_clk_i", "s_axi_aclk", "s_axis_aclk".
   Required elements for SPDIF Rx: "aud_clk_i", "s_axi_aclk", "m_axis_aclk".
 - clocks: Input clock specifier. Refer to common clock bindings.
 - reg: Base address and address length of the IP core instance.
 - interrupts-parent: Phandle for interrupt controller.
 - interrupts: List of Interrupt numbers.
 - xlnx,spdif-mode: 0 :- receiver mode
		    1 :- transmitter mode
 - xlnx,aud_clk_i: input audio clock value.

Example - SPDIF Rx:
	spdif_0: spdif@80010000 {
		clock-names = "aud_clk_i", "s_axi_aclk", "m_axis_aclk";
		clocks = <&si570_1>, <&clk 71>, <&clk 71>;
		compatible = "xlnx,spdif-2.0";
		interrupt-names = "spdif_interrupt";
		interrupt-parent = <&gic>;
		interrupts = <0 91 4>;
		reg = <0x0 0x80010000 0x0 0x10000>;
		xlnx,spdif-mode = <1>;
		xlnx,aud_clk_i = <49152913>;
	};
```

## drivers/net/wireless/mediatek/mt76/Kconfig
```kconfig
config MT76_CORE
	tristate

config MT76_LEDS
	bool
	depends on MT76_CORE
	depends on LEDS_CLASS=y || MT76_CORE=LEDS_CLASS
	default y

config MT76x2E
	tristate "MediaTek MT76x2E (PCIe) support"
	select MT76_CORE
	depends on MAC80211
	depends on PCI
	---help---
	  This adds support for MT7612/MT7602/MT7662-based wireless PCIe devices.
```

## drivers/soc/imx/Kconfig
```kconfig
# SPDX-License-Identifier: GPL-2.0-only
menu "i.MX SoC drivers"

config IMX_GPCV2_PM_DOMAINS
	bool "i.MX GPCv2 PM domains"
	depends on ARCH_MXC || (COMPILE_TEST && OF)
	depends on PM
	select PM_GENERIC_DOMAINS
	default y if SOC_IMX7D

config HAVE_IMX_MU
	bool

config HAVE_IMX8_SOC
	bool

config HAVE_IMX_SC
	bool

config HAVE_IMX_SC_PD
	bool

config HAVE_IMX_GPC_PSCI
	bool

config HAVE_IMX_RPMSG
	select RPMSG_VIRTIO
	select RPMSG
	bool
endmenu
```
