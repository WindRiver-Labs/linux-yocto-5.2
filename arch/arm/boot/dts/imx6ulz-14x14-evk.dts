// SPDX-License-Identifier: (GPL-2.0 OR MIT)
//
// Copyright 2018 NXP.

/dts-v1/;

#include "imx6ull-14x14-evk.dts"

/ {
	model = "Freescale i.MX6 ULZ 14x14 EVK Board";
	compatible = "fsl,imx6ulz-14x14-evk", "fsl,imx6ulz";

	backlight {
		status = "disabled";
	};

	pxp_v4l2 {
		status = "disabled";
	};
};
