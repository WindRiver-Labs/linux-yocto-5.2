// SPDX-License-Identifier: (GPL-2.0+ OR MIT)
/*
 * Copyright (C) 2021 Marvell International Ltd.
 *
 * Device tree for the CN9130-DB-C board.
 */

#include "cn9130.dtsi"
#include "cn913x-ep.dtsi"

#include <dt-bindings/gpio/gpio.h>

/ {
	model = "Marvell Armada CN9130-DB setup C";
};

/* Setup C has SPI1 flash as a boot device, while setup B uses NAND flash.
 * Since CP0 SPI1 and CP0 NAND are sharing some pins, they cannot be activated
 * simultaneously. When SPI controller is enabled, NAND should be disabled.
 */
&cp0_spi1 {
	status = "okay";
};

